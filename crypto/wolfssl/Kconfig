## crypto/wolfssl/Kconfig
```kconfig
#
# For a description of the syntax of this configuration file,
# see the file kconfig-language.txt in the NuttX tools repository.
#

menuconfig CRYPTO_WOLFSSL
	bool "wolfSSL SSL/TLS Cryptography Library"
	default n
	---help---
		Enable support for wolfSSL

if CRYPTO_WOLFSSL

config WOLFSSL_VERSION
	string "wolfSSL Version"
	default "5.5.4"

menuconfig WOLFCRYPT_APPS
	tristate "wolfCrypt applications"
	default n
	---help---
		Enable wolfCrypt applications

if WOLFCRYPT_APPS

config WOLFSSL_DEFAULT_TASK_STACKSIZE
	int "wolfSSL app default stack size"
	default 16384

config WOLFCRYPT_APP_BENCHMARK
	bool "wolfCrypt Benchmark application"
	default n
	---help---
		Enable the wolfCrypt benchmark application

if WOLFCRYPT_APP_BENCHMARK

config WOLFCRYPT_APP_BENCHMARK_PROGNAME
	string "Program name"
	default "wolfcrypt_benchmark"
	---help---
		This is the name of the program that will be used when the NSH ELF
		program is installed.

config WOLFCRYPT_APP_BENCHMARK_PRIORITY
	int "wolfcrypt benchmark task priority"
	default 100

config WOLFCRYPT_APP_BENCHMARK_STACKSIZE
	int "wolfcrypt benchmark stack size"
	default WOLFSSL_DEFAULT_TASK_STACKSIZE

endif

config WOLFCRYPT_APP_SELFTEST
	bool "wolfCrypt Self Test application"
	default n
	---help---
		Enable the wolfCrypt self-test app

if WOLFCRYPT_APP_SELFTEST

config WOLFCRYPT_APP_SELFTEST_PROGNAME
	string "Program name"
	default "wolfcrypt_test"
	---help---
		This is the name of the program that will be used when the NSH ELF
		program is installed.

config WOLFCRYPT_APP_SELFTEST_PRIORITY
	int "wolfcrypt self-test task priority"
	default 100

config WOLFCRYPT_APP_SELFTEST_STACKSIZE
	int "wolfcrypt self-test stack size"
	default WOLFSSL_DEFAULT_TASK_STACKSIZE

endif

endif

endif # CRYPTO_WOLFSSL
```

## examples/wolfssl/Kconfig
```kconfig
#
# For a description of the syntax of this configuration file,
# see the file kconfig-language.txt in the NuttX tools repository.
#

if CRYPTO_WOLFSSL

menuconfig EXAMPLES_WOLFSSL
	tristate "WolfSSL example applications"
	default n
	---help---
		WolfSSL TLS example applications

if EXAMPLES_WOLFSSL

config EXAMPLES_WOLFSSL_CLIENT_SERVER
	bool "WolfSSL client and server example"
	default n
	---help---
		runs both a tls client and server in the same task that connect to one
		another, requires local loopback

#config EXAMPLES_WOLFSSL_CLIENT
	#bool "WolfSSL client example"
	#default n
	#---help---
		#runs a wolfssl client that connects to the external server found in
		#/wolfssl-examples/embedded/tls-sock-server.c which can be run from any
		#computer

#if EXAMPLES_WOLFSSL_CLIENT

#config EXAMPLES_WOLFSSL_CLIENT_SERVER_ADDR
	#hex "WolfSSL client example server address"
	#default 0

#config EXAMPLES_WOLFSSL_CLIENT_SERVER_PORT
	#hex "WolfSSL client example server port"
	#default 0

#endif

#config EXAMPLES_WOLFSSL_SERVER
	#bool "WolfSSL client example"
	#default n
	#---help---
		#runs a wolfssl server that an external client can connect to, found in
		#/wolfssl-examples/embedded/tls-sock-client.c which can be run from any
		#computer

#if EXAMPLES_WOLFSSL_CLIENT

#config EXAMPLES_WOLFSSL_SERVER_PORT
	#hex "WolfSSL client example server port"
	#default 0

#endif

endif

endif
```

## examples/wolfssl_examples/Kconfig
```kconfig
#
# For a description of the syntax of this configuration file,
# see the file kconfig-language.txt in the NuttX tools repository.
#

config EXAMPLES_WOLFSSL
	tristate "Simple wolfSSL client"
	default n
	---help---
		Simple wolfSSL client that connects with TLS1.3 to a public server
```
